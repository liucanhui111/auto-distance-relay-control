## relay_s3/sdkconfig.defaults
```kconfig
# ESP32-S3 配置
CONFIG_IDF_TARGET="esp32s3"
CONFIG_ESP_DEFAULT_CPU_FREQ_MHZ_240=y
CONFIG_ESP_DEFAULT_CPU_FREQ_MHZ=y

# Flash 大小 4MB
CONFIG_ESPTOOLPY_FLASHSIZE_4MB=y
CONFIG_ESPTOOLPY_FLASHSIZE="4MB"

# 分区表
CONFIG_PARTITION_TABLE_SINGLE_APP=y

# WiFi
CONFIG_ESP_WIFI_ENABLED=y

# PSRAM (本板无 PSRAM，禁用避免启动 abort)
# CONFIG_SPIRAM is not set

# FreeRTOS
CONFIG_FREERTOS_HZ=100
```
